## firmware/esp32s3-radio-rx/main/Kconfig.projbuild
```kconfig
menu "APEX receive-only accessory"
config APEX_RADIO_RX_ENABLE
    bool "Enable explicitly reviewed CC1101 wiring"
    default n
    help
        Leave disabled until the board, voltage, pins and antenna are reviewed.
        Radio reception starts only after an explicit bounded start request.
config APEX_RADIO_SCK
    int "SPI clock GPIO"
    range -1 48
    default -1
config APEX_RADIO_MISO
    int "SPI MISO GPIO"
    range -1 48
    default -1
config APEX_RADIO_MOSI
    int "SPI MOSI GPIO"
    range -1 48
    default -1
config APEX_RADIO_CS
    int "CC1101 chip-select GPIO"
    range -1 48
    default -1
config APEX_RADIO_GDO0
    int "CC1101 GDO0 GPIO"
    range -1 48
    default -1
endmenu
```

## firmware/esp32s3-reviewed/main/Kconfig.projbuild
```kconfig
menu "APEX reviewed laboratory target"
config APEX_REVIEWED_BLE_BENCH_OPT_IN
    bool "Enable unauthenticated BLE laboratory transport"
    default n
    help
        Starts the NimBLE host and connectable advertising when the USB loop
        calls apex_ble_start. For separately authorized owned-bench use only.
        Selecting this is not permission to flash or operate a radio.
endmenu
```

## firmware/esp32s3-signed-lab/main/Kconfig.projbuild
```kconfig
menu "APEX signed-read laboratory target"
config APEX_SIGNED_READ_LAB_OPT_IN
    bool "Enable USB-only signed reads using a separately provisioned lab key"
    default n
    help
        Owned or authorised laboratory equipment only. Enables experimental
        opcode 0x70 with info/capabilities/ping. No radio or legacy dispatch.
        This option does not authorise flashing, provisioning or device use.
endmenu
```

## firmware/esp32s3-signed-lab/sdkconfig.defaults
```kconfig
# Inert unless explicitly enabled in this separate project.
# CONFIG_APEX_SIGNED_READ_LAB_OPT_IN is not set
# CONFIG_BT_ENABLED is not set
# CONFIG_ESP_WIFI_ENABLED is not set
CONFIG_ESP_CONSOLE_UART_DEFAULT=y
CONFIG_ESP_CONSOLE_SECONDARY_NONE=y
# CONFIG_ESP_CONSOLE_SECONDARY_USB_SERIAL_JTAG is not set
CONFIG_LOG_DEFAULT_LEVEL_NONE=y
CONFIG_ESP_MAIN_TASK_STACK_SIZE=16384
CONFIG_PARTITION_TABLE_CUSTOM=y
CONFIG_PARTITION_TABLE_CUSTOM_FILENAME="partitions.csv"
CONFIG_ESPTOOLPY_FLASHSIZE_2MB=y
```
